## kernel/arch/mips/xburst/soc-x1000/chip-x1500/Kconfig
```kconfig
choice
	prompt "Board type"
	depends on CHIP_X1500
	default PRODUCT_X1500_YAK

config  PRODUCT_X1500_YAK
    bool "product x1500 yak"

    config  PRODUCT_X1500_SOCSI
    bool "product x1500 socsi"
endchoice

if PRODUCT_X1500_YAK
config PRODUCT_NAME
string
default "yak"
source "arch/mips/xburst/soc-x1000/chip-x1500/yak/Kconfig"
endif

if PRODUCT_X1500_SOCSI
config PRODUCT_NAME
string
default "socsi"
source "arch/mips/xburst/soc-x1000/chip-x1500/socsi/Kconfig"
endif
```

## kernel/arch/mips/xburst/soc-x1000/chip-x1500/socsi/Kconfig
```kconfig
choice
prompt "Board Version"
depends on PRODUCT_X1500_SOCSI
default BOARD_X1500_SOCSI_V10

config BOARD_X1500_SOCSI_V10
bool "board x1500 socsi v10"
depends on PRODUCT_X1500_SOCSI

endchoice

config BOARD_NAME
string
default "socsi_v10" if BOARD_X1500_SOCSI_V10
```
